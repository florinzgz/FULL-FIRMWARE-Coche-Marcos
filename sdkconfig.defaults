## sdkconfig.defaults
```kconfig
# ============================================================================
# ESP32-S3 SDK Configuration
# ============================================================================
# Hardware: ESP32-S3-WROOM-2 N32R16V
# Flash: 32MB QIO mode
# PSRAM: 16MB OPI mode
# ============================================================================
# PSRAM configuration is set via sdkconfig for proper ESP-IDF integration
# Flash mode is controlled via platformio.ini: board_build.arduino.memory_type = qio
# ============================================================================

#
# SPI RAM (PSRAM) Configuration
#
CONFIG_ESP32S3_SPIRAM_SUPPORT=y
CONFIG_SPIRAM=y
CONFIG_SPIRAM_MODE_OCT=y
CONFIG_SPIRAM_TYPE_AUTO=y
CONFIG_SPIRAM_SPEED_80M=y

#
# PSRAM Memory Allocation Strategy
#
CONFIG_SPIRAM_USE_MALLOC=y
CONFIG_SPIRAM_MEMTEST=y
CONFIG_SPIRAM_MALLOC_ALWAYSINTERNAL=16384
CONFIG_SPIRAM_MALLOC_RESERVE_INTERNAL=32768

#
# PSRAM Size Configuration (16MB = 16777216 bytes)
#
CONFIG_SPIRAM_SIZE=16777216

#
# Cache Configuration
# Note: These settings are compatible with both QIO Flash and OPI PSRAM
#
CONFIG_ESP32S3_INSTRUCTION_CACHE_32KB=y
CONFIG_ESP32S3_DATA_CACHE_64KB=y
CONFIG_ESP32S3_ICACHE_ASSOCIATED_WAYS_8=y
CONFIG_ESP32S3_DCACHE_ASSOCIATED_WAYS_8=y
CONFIG_ESP32S3_INSTRUCTION_CACHE_LINE_32B=y
CONFIG_ESP32S3_DATA_CACHE_LINE_64B=y

#
# Memory Protection
#
CONFIG_ESP_SYSTEM_MEMPROT_FEATURE=y
CONFIG_ESP_SYSTEM_MEMPROT_FEATURE_LOCK=y

#
# Stack Configuration
# Note: Main task stack also configured in platformio.ini build_flags
# CONFIG_ARDUINO_LOOP_STACK_SIZE=32768 (defined in platformio.ini)
#
CONFIG_ESP_MAIN_TASK_STACK_SIZE=16384
CONFIG_ESP_IPC_TASK_STACK_SIZE=4096
CONFIG_PTHREAD_TASK_STACK_SIZE_DEFAULT=8192

#
# Task Watchdog Configuration
#
CONFIG_ESP_TASK_WDT_EN=y
CONFIG_ESP_TASK_WDT_TIMEOUT_S=30
CONFIG_ESP_TASK_WDT_CHECK_IDLE_TASK_CPU0=y
CONFIG_ESP_TASK_WDT_CHECK_IDLE_TASK_CPU1=y

#
# Brownout Detection
#
CONFIG_ESP_BROWNOUT_DET=y
CONFIG_ESP_BROWNOUT_DET_LVL=7  # 2.43V

#
# Heap Memory Debugging (disable in production)
#
# CONFIG_HEAP_POISONING_DISABLED=y
# CONFIG_HEAP_TRACING_OFF=y

#
# Additional RTC Memory
#
CONFIG_ESP_SYSTEM_ALLOW_RTC_FAST_MEM_AS_HEAP=y
```
